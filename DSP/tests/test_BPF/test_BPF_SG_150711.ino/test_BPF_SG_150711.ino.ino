/*
 * Use simulated data and apply bandpass filter with normalized coefficients and zero-phase.
 * 
 * Key variables:
 * 
 *   test_signal - pointer to array with simulated data
 *   in_array - buffer containing 37 samples consisting of the current and previous 36 samples
 *   after_bp - array containing the current and previous 36 samples passed through the bandpass filter
 *   index_test_signal - index of current value from test_signal
 *   index_in_array - index of current value of in_array and after_bp
 * 
 * 
 */

#include "/home/samuelwg/Arduino/libraries/ADC/ADC-master/ADC.h"
//#include "/Users/nordin/Documents/Arduino/libraries/ADC-master/ADC.h"

#define SIMULATED_SIGNAL_SELECTION 4  // 1=cosine, 2=impulse, 3 = cosine from DAC

#define BAUD_RATE 115200
#define TIMER_INT_MICROS 200
#define LENGTH_OF_DAC 10
#define LENGTH_OF_SIGNAL 37
#define N_FILTER_LENGTH 37
#define LENGTH_OF_TEST_SIGNAL 1000

float *test_signal;

float bp_filter_coeff[N_FILTER_LENGTH] = {
           0.000119, -0.000248, -0.001115, -0.002123, -0.002464, 
           -0.001282, 0.001674, 0.005529, 0.008370, 0.008080, 
           0.003597, -0.004103, -0.012010, -0.016287, -0.014199, 
           -0.005745, 0.005983, 0.016050, 0.020000, 0.016050, 
           0.005983, -0.005745, -0.014199, -0.016287, -0.012010, 
           -0.004103, 0.003597, 0.008080, 0.008370, 0.005529, 
           0.001674, -0.001282, -0.002464, -0.002123, -0.001115, -0.000248, 0.000119};

float cosine_signal[LENGTH_OF_TEST_SIGNAL] = {
   1.        ,  0.80901699,  0.30901699, -0.30901699, -0.80901699,
       -1.        , -0.80901699, -0.30901699,  0.30901699,  0.80901699,
        1.        ,  0.80901699,  0.30901699, -0.30901699, -0.80901699,
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       -1.        , -0.80901699, -0.30901699,  0.30901699,  0.80901699 };
       
 float dac_output[LENGTH_OF_TEST_SIGNAL] = {
 4095.        ,  3703.96229598,  2680.21229598,  1414.78770402,
         391.03770402,     0.        ,   391.03770402,  1414.78770402,
        2680.21229598,  3703.96229598,  4095.        ,  3703.96229598,
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         391.03770402,  1414.78770402,  2680.21229598,  3703.96229598      
 
 
 
 };
 
 float rect_pulse[1000] = {
   1, 1, 1, 1, 1, 0, 0, 0, 0, 0, 0, 0, 0, 0, 0, 0, 0, 0, 0, 0, 0, 0, 0,
       0, 0, 0, 0, 0, 0, 0, 0, 0, 0, 0, 0, 0, 0, 0, 0, 0, 0, 0, 0, 0, 0, 0,
       0, 0, 0, 0, 0, 0, 0, 0, 0, 0, 0, 0, 0, 0, 0, 0, 0, 0, 0, 0, 0, 0, 0,
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       0, 0, 0, 0, 0, 0, 0, 0, 0, 0, 0
 
 };

float volatile in_array[LENGTH_OF_SIGNAL]; 
float volatile after_BPF[LENGTH_OF_SIGNAL];

IntervalTimer timer0;
int dac_lut[LENGTH_OF_DAC]; 
float twopi = 3.14159265359 * 2;

int volatile index_test_signal;
int volatile index_in_array;
int volatile zero_phase_index;
int volatile index_dac;

int n_mid_coef = (N_FILTER_LENGTH-1)/2;
//int n_mid_coef = 2; //should be (N_FILTER_LENGTH-1)/2, but this works. Needs figured out why

//-----------------------------------------------------------------
void LUT(){
   for(int i = 0; i < LENGTH_OF_DAC; i++){
     dac_lut[i] = (int) ((cos(twopi*((float) i)/ LENGTH_OF_DAC) + 1)*2050);   
   }
}

//-----------------------------------------------------------------
void execute_BPF() {
  after_BPF[index_in_array] = in_array[index_in_array] * bp_filter_coeff[0];
  for(int fir_coef_index = 1; fir_coef_index < N_FILTER_LENGTH; fir_coef_index++){
    int fir_delayline_index = index_in_array - fir_coef_index;
    if (fir_delayline_index < 0) {
      fir_delayline_index += N_FILTER_LENGTH;
    }
    after_BPF[index_in_array] += in_array[fir_delayline_index] * bp_filter_coeff[fir_coef_index];
  }  
}

//-----------------------------------------------------------------
void ISR(){
  
  analogWrite(A14, dac_lut[index_dac]); 
  
  in_array[index_in_array] = test_signal[index_test_signal]; 
  execute_BPF();
  // Calculate index into in_array that corresponds to a zero-phase filter
  zero_phase_index = index_in_array - n_mid_coef;
  if (zero_phase_index < 0) zero_phase_index += N_FILTER_LENGTH;
  // Write to serial comma separated simulated value and zero-phase bandpass filtered value
  Serial.print(in_array[zero_phase_index]); Serial.print(",");
  Serial.println(after_BPF[index_in_array], 5);
  //Serial.println(after_BPF[index_in_array], 5);
  // Update index variables
  index_in_array++;
  if(index_in_array >= LENGTH_OF_SIGNAL) index_in_array = 0;
  index_test_signal++;
  if(index_test_signal >= LENGTH_OF_TEST_SIGNAL) index_test_signal = 0;
  index_dac++;
  if(index_dac >= LENGTH_OF_DAC) index_dac = 0;
}

//-----------------------------------------------------------------
void timer_setup() { //setup interrupt
    timer0.begin(ISR, TIMER_INT_MICROS);  
} 

//-----------------------------------------------------------------
float gain_magn(float h[], float omega) {
    float cos_term = 0.0;
    float sin_term = 0.0;
    for (int k=0; k<N_FILTER_LENGTH; k++) {
        cos_term += bp_filter_coeff[k] * cos(twopi*omega*k);
        sin_term += bp_filter_coeff[k] * sin(twopi*omega*k);
    }
    float gain_mag = sqrt(cos_term*cos_term + sin_term*sin_term);
    return gain_mag;
}

float temp_signal[LENGTH_OF_TEST_SIGNAL];

void setup() {

  switch (SIMULATED_SIGNAL_SELECTION) {
    case 1:
      test_signal = cosine_signal;
      // Add 1 to test signal so it is a raised cosine
      for (int i=0; i<LENGTH_OF_TEST_SIGNAL; i++) {
          test_signal[i] += 1.0;
      }
      break;
    case 2:
      for (int ii=0; ii<LENGTH_OF_TEST_SIGNAL; ii++) temp_signal[ii] = 0.0;
      temp_signal[LENGTH_OF_TEST_SIGNAL/2] = 1.0;
      test_signal = temp_signal;
      break;
     case 3:
         test_signal = dac_output; 
     
       break;
       
     case 4:
         test_signal = rect_pulse;
     
       break; 
    default: 
      break;
   }
  
  index_in_array = 0; 
  index_test_signal = 0; 
  index_dac = 0; 
  
  analogWriteResolution(12); // Set up DAC resolution

  // Normalize bandpass filter coefficients
  float gain_mag = gain_magn(bp_filter_coeff, 0.1);
  for (int k=0; k<N_FILTER_LENGTH; k++) {
      bp_filter_coeff[k] /= gain_mag;
  }
  Serial.begin(BAUD_RATE);
  Serial.flush();
  delay(1000); 
  timer_setup();
  //Serial.print("\n\rHello! Right now we are testing the BPF");

}

void loop() {
  // put your main code here, to run repeatedly:

}
